## conf/layer.conf
```bitbake
BBPATH .= ":${LAYERDIR}"

BBFILES += "\
            ${LAYERDIR}/recipes-*/*/*.bb \
            ${LAYERDIR}/recipes-*/*/*.bbappend \
           "

BBFILE_COLLECTIONS += "rdk-broadband"
BBFILE_PATTERN_rdk-broadband := "^${LAYERDIR}/"
BBFILE_PRIORITY_rdk-broadband = "6"

BBMASK .= "${@bb.utils.contains('DISTRO_FEATURES', 'webconfig_bin', '', '|meta-rdk-broadband/recipes-support/webcfg/webcfg_%.bbappend', d)}"

# Additional license directories.
LICENSE_PATH += "${LAYERDIR}/licenses"

LAYERSERIES_COMPAT_rdk-broadband = "zeus dunfell"
```
